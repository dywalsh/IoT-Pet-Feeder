## sample.yaml
```
sample:
  description: TBD
  name: TBD
tests:
  test_bt:
    harness: net
    platform_whitelist: nrf52_pca10040
    tags: net mqtt bluetooth
```

## prj.conf
```kconfig
CONFIG_INIT_STACKS=y
CONFIG_GPIO=y
CONFIG_SERIAL=n
CONFIG_PRINTK=y
CONFIG_USE_SEGGER_RTT=y
CONFIG_RTT_CONSOLE=y
CONFIG_LOG_BACKEND_RTT_MODE_DROP=y

CONFIG_NETWORKING=y

CONFIG_NET_L2_BT=y
# Include the following if communicating with a Linux kernel version < 4.12
# CONFIG_NET_L2_BT_ZEP1656=y
CONFIG_NET_L2_BT_SEC_LEVEL=1

CONFIG_NET_IPV4=n
CONFIG_NET_IPV6=y
CONFIG_NET_TCP=y
CONFIG_NET_UDP=y
CONFIG_NET_ARP=y
CONFIG_NET_IPV6_RA_RDNSS=y
CONFIG_NET_IPV6_MAX_NEIGHBORS=6
CONFIG_NET_MAX_CONTEXTS=5
CONFIG_NET_LOG=y
CONFIG_NET_SHELL=y

CONFIG_NET_PKT_RX_COUNT=16
CONFIG_NET_PKT_TX_COUNT=16

CONFIG_NET_BUF_DATA_SIZE=256
CONFIG_NET_BUF_RX_COUNT=15
CONFIG_NET_BUF_TX_COUNT=15

CONFIG_NET_IF_UNICAST_IPV6_ADDR_COUNT=3
CONFIG_NET_IF_MCAST_IPV6_ADDR_COUNT=5

CONFIG_NET_CONFIG_SETTINGS=y
CONFIG_NET_CONFIG_PEER_IPV6_ADDR="fe80::1a:7dff:feda:7113"
CONFIG_NET_CONFIG_BT_NODE=y

CONFIG_MQTT_LIB=y
CONFIG_JSON_LIBRARY=y

CONFIG_MAIN_STACK_SIZE=2048

CONFIG_ENTROPY_GENERATOR=y
CONFIG_TEST_RANDOM_GENERATOR=y
CONFIG_TIMER_RANDOM_GENERATOR=y

CONFIG_BT_SIGNING=y
CONFIG_BT_RX_STACK_SIZE=1024
CONFIG_BT_DEVICE_NAME="Zeph-Joe"
# App may not fit in RAM with ECC enabled
CONFIG_BT_TINYCRYPT_ECC=n
CONFIG_BT_L2CAP_TX_BUF_COUNT=3
CONFIG_BT_L2CAP_TX_MTU=65
CONFIG_BT_L2CAP_DYNAMIC_CHANNEL=y
CONFIG_BT_HCI_TX_STACK_SIZE=640
CONFIG_BT_HCI_HOST=y
CONFIG_BT_HCI_CMD_COUNT=2
CONFIG_BT_RX_BUF_COUNT=20
# Test lower value to save RAM (orig 1024)
CONFIG_BT_RX_BUF_LEN=512
CONFIG_BT_RECV_IS_RX_THREAD=y
CONFIG_BT_DEBUG_LOG=y
```

## src/main.c
```c
/*
 * Copyright (c) 2017 Intel Corporation
 *
 * SPDX-License-Identifier: Apache-2.0
 */

 #define LOG_MODULE_NAME net_tb_device
 #define NET_LOG_LEVEL LOG_LEVEL_DBG

#include <zephyr.h>

#include <net/net_context.h>

#include <misc/printk.h>
#include <string.h>
#include <stdio.h>
#include <errno.h>

#if defined(CONFIG_NET_L2_BT)
#include <bluetooth/bluetooth.h>
#include <bluetooth/conn.h>
#endif

#include "tb_pubsub.h"
#include "sensors.h"
#include "lights.h"
#include "config.h"
#include "time.h"


#define ATTR_UPDATE_INTERVAL 15000

#define RC_STR(rc)	((rc) == 0 ? "OK" : "ERROR")
#define PRINT_RESULT(func, rc)	\
	printf("[%s:%d] %s: %d <%s>\n", __func__, __LINE__, \
	       (func), rc, RC_STR(rc))

static void update_attributes()
{
	static char payload[128];

	/* Formulate the JSON payload for the attribute update */
	snprintf(payload, sizeof(payload), "{\"firmware_version\":\"%s\", \"serial_number\":\"%s\", \"uptime\":\"%d\"}",
		"1.2.3",
		"jdukes-001",
		(uint32_t)k_uptime_get_32() / 1000);

	tb_publish_attributes(payload);
}

#if defined(CONFIG_NET_L2_BT)
static bool bt_connected;

static
void bt_connect_cb(struct bt_conn *conn, u8_t err)
{
	bt_connected = true;
}

static
void bt_disconnect_cb(struct bt_conn *conn, u8_t reason)
{
	bt_connected = false;
	printf("bt disconnected (reason %u)\n", reason);
}

static
struct bt_conn_cb bt_conn_cb = {
	.connected = bt_connect_cb,
	.disconnected = bt_disconnect_cb,
};
#endif

static int network_setup(void)
{

#if defined(CONFIG_NET_L2_BT)
	const char *progress_mark = "/-\\|";
	int i = 0;
	int rc;

	rc = bt_enable(NULL);
	if (rc && rc != -EALREADY) {
		printf("bluetooth init failed\n");
		return rc;
	}

	bt_conn_cb_register(&bt_conn_cb);

	printf("\nwaiting for bt connection: ");
	while (bt_connected == false) {
		k_sleep(250);
		printf("%c\b", progress_mark[i]);
		i = (i + 1) % (sizeof(progress_mark) - 1);
	}
	printf("\n");
#endif

	return 0;
}

void main(void)
{
	int rc;

	rc = network_setup();
	PRINT_RESULT("network_setup", rc);
	if (rc < 0) {
		return;
	}

	tb_pubsub_start();
	sensors_start();
	lights_init();

	while (true) {
		k_sleep(ATTR_UPDATE_INTERVAL);
		printf("Updating attributes\n");
		if (hasTime()) {
			printf("Current unix time: %d\n", getTime());			
		}
		update_attributes();
	}
}
```

## src/sensors.c
```c
#include <zephyr.h>
#include <board.h>
#include <device.h>
#include <gpio.h>
#include <misc/printk.h>
#include "config.h"
#include "tb_pubsub.h"

#define BTN_PORT SW0_GPIO_CONTROLLER
#define BTN_COUNT 4

const u32_t btn_arr[BTN_COUNT] = {
    SW0_GPIO_PIN,
    SW1_GPIO_PIN,
    SW2_GPIO_PIN,
    SW3_GPIO_PIN
};

struct device *btn_dev;
struct gpio_callback btn_callback;

u32_t state[4];
int weight = 0;

int btn_alert_handler(struct k_alert *alert);
K_ALERT_DEFINE(btn_alert, btn_alert_handler, 10);

void btn_handler(struct device *port, struct gpio_callback *cb,
					u32_t pins)
{
    /* Context: interrupt handler */

	printf("Signalling alert!\n");
	k_alert_send(&btn_alert);
}

int btn_alert_handler(struct k_alert *alert)
{
	int value;
	char payload[16];
	int newWeight = weight;
    /* Context: Zephy kernel workqueue thread */

	printf("Button event!\n");

    /* Iterate over button 0 and 1*/

	for (u32_t i = 0; i < 2; i++) {
		gpio_pin_read(btn_dev, btn_arr[i], &value);
		if (value == 0) {
			if (i == 0 && weight >= 25) {
				newWeight = weight - 25;
			} else if (i == 1 && weight <= 75) {
				newWeight = weight + 25;
			}

			if (newWeight != weight) {
				weight = newWeight;
	            /* Formulate JSON in the format expected by thingsboard.io */
				snprintf(payload, sizeof(payload), "{\"weight\":%d}", weight);
				printf("weight %d\n", weight);
				tb_publish_telemetry(payload);
			}

			state[i] = value;
		}
	}

	return 0;
}

void sensors_start()
{
	btn_dev = device_get_binding(BTN_PORT);

	for (u32_t i = 0; i < BTN_COUNT; i++) {
		gpio_pin_configure(btn_dev, btn_arr[i], GPIO_DIR_IN | GPIO_INT
			| GPIO_INT_ACTIVE_LOW | GPIO_INT_EDGE | GPIO_PUD_PULL_UP);
	}

	gpio_init_callback(&btn_callback, btn_handler,
		BIT(btn_arr[0]) | BIT(btn_arr[1]) |
		BIT(btn_arr[2]) | BIT(btn_arr[3])
	);

	gpio_add_callback(btn_dev, &btn_callback);

	for (u32_t i = 0; i < BTN_COUNT; i++) {
		gpio_pin_enable_callback(btn_dev, btn_arr[i]);
		gpio_pin_read(btn_dev, btn_arr[i], &state[i]);
	}
}
```

## src/tb_pubsub.c
```c
/*
 * Copyright (c) 2017 Intel Corporation
 *
 * SPDX-License-Identifier: Apache-2.0
 */

#define LOG_MODULE_NAME net_tb_pubsub
#define NET_LOG_LEVEL LOG_LEVEL_DBG

#include "tb_pubsub.h"

#include <zephyr.h>
#include <net/mqtt.h>
#include <stdlib.h>

#include <misc/printk.h>
#include <string.h>
#include <stdio.h>
#include <bluetooth/bluetooth.h>

#include <json.h>

#include "lights.h"

#include "config.h"
#include "time.h"

#define MAX_PENDING_PUB_MSGS 8
#define PUBSUB_STACK_SIZE 1024
#define PUBSUB_PRIORITY 5

static const char *TB_ATTRIBUTES_TOPIC = "v1/devices/me/attributes";
static const char *TB_TELEMETRY_TOPIC = "v1/devices/me/telemetry";
static const char *TB_RPC_TOPIC[] = {"v1/devices/me/rpc/request/+"};
static const enum mqtt_qos TB_RPC_QOS[] = {MQTT_QoS0};

/* For some reason thingsboard.io is very slow to respond to TX Connect
 * requests. We'll implement them using an alert to signal when
 * a connection is established. */
K_ALERT_DEFINE(tb_connack_alert, K_ALERT_DEFAULT, 1);

#define RC_STR(rc)	((rc) == 0 ? "OK" : "ERROR")
#define PRINT_RESULT(func, rc)	\
	printf("[%s:%d] %s: %d <%s>\n", __func__, __LINE__, \
	       (func), rc, RC_STR(rc))

/* Container for some structures used by the MQTT pubsub app. */
static struct pubsub_ctx {
	/**
	 * The connect message structure is only used during the connect
	 * stage. Developers must set some msg properties before calling the
	 * mqtt_tx_connect routine. See below.
	 */
	struct mqtt_connect_msg connect_msg;

	/**
	 * This is the MQTT application context variable.
	 */
	struct mqtt_ctx mqtt_ctx;
} pubsub_ctx;

/* MQTT publish message descriptor */
static struct pub_msg {
	struct k_mem_block mem_block;
	struct mqtt_publish_msg mqtt_publish_msg;
};

/* Message Queue and Memory Pool for publish message descriptors and
 * associated JSON payload */
K_MSGQ_DEFINE(msgq, sizeof(struct pub_msg), MAX_PENDING_PUB_MSGS, 4);
K_MEM_POOL_DEFINE(pub_pool, 16, 128, 8, 4);

/* Must match the JSON payload format specified by JSON_OBJ_DESCR... below */
struct rpc_putLights {
	const char* method;
	struct rpc_putLights_params {
		int ledno;
		bool value;
	} params;
};

void handle_putLights(char *json, int json_len)
{
	printf("[%s:%d] parsing: %s\n",	__func__, __LINE__, json);

	/* Refer to zephyr/include/json.h !!! */

	/* JSON RPC params for putLights */
	static const struct json_obj_descr rpc_descr_params[] = {
		JSON_OBJ_DESCR_PRIM(struct rpc_putLights_params, ledno, JSON_TOK_NUMBER),
		JSON_OBJ_DESCR_PRIM(struct rpc_putLights_params, value, JSON_TOK_TRUE),
	};

	/* JSON generic thingsboard.io RPC */
	static const struct json_obj_descr rpc_descr[] = {
		JSON_OBJ_DESCR_PRIM(struct rpc_putLights, method, JSON_TOK_STRING),
		JSON_OBJ_DESCR_OBJECT(struct rpc_putLights, params, rpc_descr_params)
	};

	struct rpc_putLights rx_rpc={};

	json_obj_parse(json, json_len, rpc_descr, ARRAY_SIZE(rpc_descr), &rx_rpc);

	printf("[%s:%d] parsed method: %s, params: led%d=%s\n",
		__func__, __LINE__, rx_rpc.method, rx_rpc.params.ledno, rx_rpc.params.value ? "ON" : "OFF");

	/* Call light control provided by lights.c */
	putLights(rx_rpc.params.ledno, rx_rpc.params.value);
}

void handle_fillUpFood(char *json, int json_len)
{
	printf("[%s:%d] parsing: %s\n",	__func__, __LINE__, json);

	putLights(0, true);
	putLights(1, true);
	putLights(2, true);
	putLights(3, true);
}

/* Handles receiving time broadcasts*/
void handle_setTime(char *json, int json_len)
{
	printf("[%s:%d] parsing: %s\n",	__func__, __LINE__, json);
	char timeChars[14];
	memcpy(timeChars, &json[26], 14);
	int time = atoi(timeChars);
	setTime(time);
}
void handle_updateSchedule(char *json, int json_len)
{
	printf("[%s:%d] parsing: %s\n",	__func__, __LINE__, json);
/*	char* tempString = malloc(4);
	memcpy(tempString, &json[25], 4);
	tempString[4] = '\0';*/

	char payload[64];

	//ts = time schedule
    char ts1[5];
	char ts2[5];
    char ts3[5];
	for(int i = 0; i<4; i++)
	{
		ts1[i] = json[i+37];
	}
			ts1[4] = '\0';

	for(int j = 0; j<4; j++)
	{
		ts2[j] = json[j+42];
	}
			ts2[4] = '\0';

	for (int k = 0; k<4; k++)
	{
		ts3[k] = json[k+47];
	}
			ts3[4] = '\0';

			int num1 = atoi(ts1);
			int num2 = atoi(ts2);
			int num3 = atoi(ts3);


	snprintf(payload, sizeof(payload), "{\"st1\":\"%s\", \"st2\":\"%s\", \"st3\":\"%s\"}", ts1, ts2, ts3);

		printf("test: %d\n %d\n %d", num1,num2,num3);


	tb_publish_telemetry(payload);

}

/*
 * Process an RPC request received from the thingsboard instance
 */
void handle_rpc(char *json, int json_len)
{
	/* Ideally we would parse the JSON fully here extracting both the method
	 * name and the parameters. However, the limited JSON implementation
	 * in Zephyr means that we must know the structure of the entire JSON
	 * payload when it being parsed but we can't know that here until we
	 * know the RPC method name.
	 *
	 * As a work-around, we do a rudimentary string
	 * comparison to look for supported RPC method names (e.g. putLights) and
	 * then pass the JSON on to be fully parsed in a RPC method-specific
	 * function.
	 */

	if ( strncmp(&json[11], "putLights", strlen("putLights")) == 0 ) {
		handle_putLights(json, json_len);
	}
	else if ( strncmp(&json[11], "fillUpFood", strlen("fillUpFood")) == 0 ) {
		handle_fillUpFood(json, json_len);
	}
	else if ( strncmp(&json[11], "time", strlen("time")) == 0 ) {
		handle_setTime(json, json_len);
	} 
}

/* The signature of this routine must match the connect callback declared at
 * the mqtt.h header.
 */
static void connect_cb(struct mqtt_ctx *mqtt_ctx)
{
	printf("[%s:%d]\n", __func__, __LINE__);

	k_alert_send(&tb_connack_alert);
}

/* The signature of this routine must match the disconnect callback declared at
 * the mqtt.h header.
 */
static void disconnect_cb(struct mqtt_ctx *mqtt_ctx)
{
	printf("[%s:%d]\n", __func__, __LINE__);

}

/**
 * The signature of this routine must match the publish_tx callback declared at
 * the mqtt.h header.
 *
 * Applications must keep a "message database" with pkt_id's. So far, this is
 * not implemented here. For example, if we receive a PUBREC message with an
 * unknown pkt_id, this routine must return an error, for example -EINVAL or
 * any negative value.
 */
static int publish_tx_cb(struct mqtt_ctx *mqtt_ctx, u16_t pkt_id,
		      enum mqtt_packet type)
{
	const char *str;
	int rc = 0;

	switch (type) {
	case MQTT_PUBACK:
		str = "MQTT_PUBACK";
		break;
	case MQTT_PUBCOMP:
		str = "MQTT_PUBCOMP";
		break;
	case MQTT_PUBREC:
		str = "MQTT_PUBREC";
		break;
	default:
		rc = -EINVAL;
		str = "Invalid MQTT packet";
	}

	printf("[%s:%d] <%s> packet id: %u\n", __func__, __LINE__, str, pkt_id);

	return rc;
}


/**
 * The signature of this routine must match the publish_rx callback declared at
 * the mqtt.h header.
 */
static int publish_rx_cb(struct mqtt_ctx *ctx, struct mqtt_publish_msg *msg,
		  u16_t pkt_id, enum mqtt_packet type)
{
	const char *str;
	int rc = 0;

	/* Received a MQTT message published to a topic to which
	 * we have subscribed. In this case, this will mean an RPC
	 * request originated from our thingsboard instance. */

	switch (type) {
	case MQTT_PUBLISH:
		str = "MQTT_PUBLISH";
		break;
	default:
		rc = -EINVAL;
		str = "Invalid or unsupported MQTT packet";
	}

	msg->msg[msg->msg_len] = 0;

	printf("[%s:%d] <%s> packet id: %u\n    topic: %s\n    payload: %s\n",
		__func__, __LINE__, str, pkt_id, msg->topic, msg->msg);

	/* Pass on for RPC processing */
	handle_rpc(msg->msg, msg->msg_len);

	return rc;
}

static int subscribe_cb(struct mqtt_ctx *ctx, u16_t pkt_id,
		 u8_t items, enum mqtt_qos qos[])
{
	/* Successful subscription to MQTT topic */

	printf("[%s:%d] <%s> packet id: %u\n", __func__, __LINE__, "MQTT_SUBACK", pkt_id);
	return 0;
}


static int unsubscribe_cb(struct mqtt_ctx *ctx, u16_t pkt_id)
{
	printf("[%s:%d] <%s> packet id: %u\n", __func__, __LINE__, "MQTT_UNSUBACK", pkt_id);
	return 0;
}

/**
 * The signature of this routine must match the malformed callback declared at
 * the mqtt.h header.
 */
static void malformed_cb(struct mqtt_ctx *mqtt_ctx, u16_t pkt_type)
{
	printf("[%s:%d] pkt_type: %u\n", __func__, __LINE__, pkt_type);
}

K_THREAD_STACK_DEFINE(pubsub_stack_area, PUBSUB_STACK_SIZE);
struct k_thread pubsub_thread_desc;

/**
 * Thread to manage thingsboard.io communication
 */
void pubsub_thread(void * unused1, void * unused2, void * unused3)
{
	ARG_UNUSED(unused1);
	ARG_UNUSED(unused2);
	ARG_UNUSED(unused3);

	int i, rc;
	char token[BT_ADDR_STR_LEN];
	struct bt_le_oob oob;
	struct pub_msg pub_msg;

	/* Set everything to 0 and later just assign the required fields. */
	memset(&pubsub_ctx, 0x00, sizeof(pubsub_ctx));

	/* connect, disconnect and malformed may be set to NULL */
	pubsub_ctx.mqtt_ctx.connect = connect_cb;

	pubsub_ctx.mqtt_ctx.disconnect = disconnect_cb;
	pubsub_ctx.mqtt_ctx.malformed = malformed_cb;
	pubsub_ctx.mqtt_ctx.publish_tx = publish_tx_cb;
	pubsub_ctx.mqtt_ctx.publish_rx = publish_rx_cb;
	pubsub_ctx.mqtt_ctx.subscribe = subscribe_cb;

	pubsub_ctx.mqtt_ctx.net_init_timeout = APP_NET_INIT_TIMEOUT;
	pubsub_ctx.mqtt_ctx.net_timeout = APP_TX_RX_TIMEOUT;

	pubsub_ctx.mqtt_ctx.peer_addr_str = SERVER_ADDR;
	pubsub_ctx.mqtt_ctx.peer_port = SERVER_PORT;

	/* IMPORTANT: Using the Bluetooth address as the thingsboard.io
	 * ACCESS TOKEN. You MUST configure the ACCESS TOKEN in your
	 * thingsboard.io instance. */
	bt_le_oob_get_local(BT_ID_DEFAULT, &oob);
	bt_addr_to_str(&oob.addr.a, token, sizeof(token));
	pubsub_ctx.connect_msg.user_name = token;

	printf("Connecting with thingsboard.io token: %s\n", token);

	pubsub_ctx.connect_msg.user_name_len = strlen(pubsub_ctx.connect_msg.user_name);

	pubsub_ctx.connect_msg.client_id = MQTT_CLIENTID;
	pubsub_ctx.connect_msg.client_id_len = strlen(MQTT_CLIENTID);

	/* Must be 1 - 0 not yet supported by Zephyr */
	pubsub_ctx.connect_msg.clean_session = 1;

	/* We are both a MQTT APP PUBLISHER and a MQTT APP SUBSCRIBER!! */
	rc = mqtt_init(&pubsub_ctx.mqtt_ctx, MQTT_APP_PUBLISHER_SUBSCRIBER);
	PRINT_RESULT("mqtt_init", rc);

	if (rc != 0) {
		goto exit_pub;
	}

	// To allow us to start wireshark!!!
	k_sleep(10000);

	/* Open a TCP connection to the thingsboard.io instance */
	i = 0;
	do {
		k_sleep(APP_TX_RX_TIMEOUT);
		rc = mqtt_connect(&pubsub_ctx.mqtt_ctx);
		PRINT_RESULT("mqtt_connect", rc);
	} while (rc != 0 && i++ < APP_CONN_TRIES);

	if (rc != 0) {
		goto exit_pub;
	}

	/* Open an MQTT session to the thingsboard.io instance */
	i = 0;
	do {
		rc = mqtt_tx_connect(&pubsub_ctx.mqtt_ctx, &pubsub_ctx.connect_msg);
		PRINT_RESULT("mqtt_tx_connect", rc);
		k_alert_recv(&tb_connack_alert, APP_TX_CONN_TIMEOUT);
	} while (rc == 0 && i++ < APP_TX_CONN_TRIES && !pubsub_ctx.mqtt_ctx.connected);

	if (!pubsub_ctx.mqtt_ctx.connected) {
		mqtt_close(&pubsub_ctx.mqtt_ctx);
		goto exit_pub;
	}

	/* Subscribe to RPC messages (e.g. for LED control). When they arrive, the
	 * RPC requests will appear first in publish_rx_cb(...) and will be passed on
	 * to  handle_rpc(...), which you should customize for your own
	  application requirments. */
	rc = mqtt_tx_subscribe(&pubsub_ctx.mqtt_ctx, sys_rand32_get(), 1,
		TB_RPC_TOPIC, TB_RPC_QOS);

	PRINT_RESULT("mqtt_tx_subscribe", rc);


	/* From here we enter an infinite loop, blocking until we receive a
	 * pub_msg descriptor from another part of the application. Note that
	 * after sending a publish message, we must free the allocated
	 * Zephyr memory pool block. */
	while ((rc = k_msgq_get(&msgq, &pub_msg, K_FOREVER)) == 0) {
		rc = mqtt_tx_publish(&pubsub_ctx.mqtt_ctx, &pub_msg.mqtt_publish_msg);
		k_mem_pool_free(&pub_msg.mem_block);
		PRINT_RESULT("mqtt_tx_publish", rc);
	}

	/* Something has failed if we get to here!!! */

	/* Disconnect */
	rc = mqtt_tx_disconnect(&pubsub_ctx.mqtt_ctx);
	PRINT_RESULT("mqtt_tx_disconnect", rc);

	k_sleep(APP_TX_RX_TIMEOUT);

	/* Close TCP connection */
	rc = mqtt_close(&pubsub_ctx.mqtt_ctx);
	PRINT_RESULT("mqtt_close", rc);

exit_pub:
	printf("\nPublisher terminated!!\n");
}

int prepare_msg(struct pub_msg *pub_msg, const char *topic, const char *payload)
{
	/* allocate a buffer (block) for the message */
	if (k_mem_pool_alloc(&pub_pool, &pub_msg->mem_block, strlen(payload), K_NO_WAIT) == 0)
	{
		/* copy the payload to the allocated buffer */
		strcpy(pub_msg->mem_block.data, payload);

		/* prepare the remainder of the message descriptor */
		pub_msg->mqtt_publish_msg.msg = pub_msg->mem_block.data;
		pub_msg->mqtt_publish_msg.msg_len = strlen(pub_msg->mqtt_publish_msg.msg);
		pub_msg->mqtt_publish_msg.qos = MQTT_QoS0;
		pub_msg->mqtt_publish_msg.topic = topic;
		pub_msg->mqtt_publish_msg.topic_len = strlen(pub_msg->mqtt_publish_msg.topic);
		pub_msg->mqtt_publish_msg.pkt_id = sys_rand32_get();

		return 0;
	} else {
		return -ENOMEM;
	}
}

void tb_publish_attributes(const char * attr_payload)
{
	struct pub_msg pub_msg;
	int rc;

	/* Prepare the pub_msg descriptor for telemetry */
	rc = prepare_msg(&pub_msg, TB_ATTRIBUTES_TOPIC, attr_payload);

	if (rc != 0) {
		PRINT_RESULT("prepare_msg", rc);
		return;
	}

	printf("tb_publish_attributes: %s\n", attr_payload);

	/* Send it to the publish message queue */
	rc = k_msgq_put(&msgq, &pub_msg, K_NO_WAIT);

	/* If we couldn't send it to the message queue, we need to free memory
	 * that was allocated for the JSON payload */

	if (rc != 0) {
		k_mem_pool_free(&pub_msg.mem_block);
		PRINT_RESULT("k_msgq_put", rc);
	}
}

void tb_publish_telemetry(const char * tlmtry_payload)
{
	struct pub_msg pub_msg;
	int rc;

	/* Prepare the pub_msg descriptor for telemetry */
	rc = prepare_msg(&pub_msg, TB_TELEMETRY_TOPIC, tlmtry_payload);

	if (rc != 0) {
		PRINT_RESULT("prepare_msg", rc);
	}

	printf("tb_publish_telemetry: %s\n", pub_msg.mqtt_publish_msg.msg);

	/* Send it to the publish message queue */
	rc = k_msgq_put(&msgq, &pub_msg, K_NO_WAIT);

	/* If we couldn't send it to the message queue, we need to free memory
	 * that was allocated for the JSON payload */
	if (rc != 0) {
		k_mem_pool_free(&pub_msg.mem_block);
		PRINT_RESULT("k_msgq_put", rc);
	}
}

void tb_pubsub_start()
{
	k_tid_t tt_tid = k_thread_create(&pubsub_thread_desc, pubsub_stack_area,
                                 K_THREAD_STACK_SIZEOF(pubsub_stack_area),
                                 pubsub_thread,
                                 NULL, NULL, NULL,
                                 PUBSUB_PRIORITY, 0, K_NO_WAIT);
}
```

## src/time.c
```c
#include <stdbool.h>
#include "time.h"
int time_unix;


void setTime(int time)
{
	time_unix = time;
}

int getTime()
{
	return time_unix;
}

bool hasTime()
{
	if (time_unix != 0){
		return true;
	}

	return false;
}
```

## src/time.h
```c
extern int time_unix;

int getTime();

void setTime(int time);

bool hasTime();
```
