## prj.conf
```kconfig
CONFIG_GPIO=y
CONFIG_ADC=y
CONFIG_ADC_NRFX_SAADC=y
CONFIG_ADC_ASYNC=y
CONFIG_ADC_0=y
CONFIG_LOG=y
CONFIG_LOG_BACKEND_RTT_MODE_DROP=y
CONFIG_ADC_LOG_LEVEL_INF=y
CONFIG_SERIAL=n
CONFIG_PRINTK=y
CONFIG_RTT_CONSOLE=y
CONFIG_USE_SEGGER_RTT=y
CONFIG_BT=n
CONFIG_PWM=y
CONFIG_PRINTK=y

CONFIG_INIT_STACKS=y

CONFIG_NETWORKING=y

CONFIG_NET_L2_BT=y
# Include the following if communicating with a Linux kernel version < 4.12
CONFIG_NET_L2_BT_ZEP1656=y
CONFIG_NET_L2_BT_SEC_LEVEL=1

CONFIG_NET_IPV4=n
CONFIG_NET_IPV6=y
CONFIG_NET_TCP=y
CONFIG_NET_UDP=y
CONFIG_NET_ARP=y
CONFIG_NET_IPV6_RA_RDNSS=y
CONFIG_NET_IPV6_MAX_NEIGHBORS=6
CONFIG_NET_MAX_CONTEXTS=5
CONFIG_NET_LOG=y
CONFIG_NET_SHELL=y

CONFIG_NET_PKT_RX_COUNT=16
CONFIG_NET_PKT_TX_COUNT=16

CONFIG_NET_BUF_DATA_SIZE=256
CONFIG_NET_BUF_RX_COUNT=15
CONFIG_NET_BUF_TX_COUNT=15

CONFIG_NET_IF_UNICAST_IPV6_ADDR_COUNT=3
CONFIG_NET_IF_MCAST_IPV6_ADDR_COUNT=5

CONFIG_NET_CONFIG_SETTINGS=y
CONFIG_NET_CONFIG_PEER_IPV6_ADDR="fe80::21a:7dff:feda:7113"
CONFIG_NET_CONFIG_BT_NODE=y

CONFIG_MQTT_LIB=y
CONFIG_JSON_LIBRARY=y

CONFIG_MAIN_STACK_SIZE=2048

CONFIG_ENTROPY_GENERATOR=y
CONFIG_TEST_RANDOM_GENERATOR=y
CONFIG_TIMER_RANDOM_GENERATOR=y

CONFIG_BT_SIGNING=y
CONFIG_BT_RX_STACK_SIZE=1024
CONFIG_BT_DEVICE_NAME="Zeph-Joe"
# App may not fit in RAM with ECC enabled
CONFIG_BT_TINYCRYPT_ECC=n
CONFIG_BT_L2CAP_TX_BUF_COUNT=3
CONFIG_BT_L2CAP_TX_MTU=65
CONFIG_BT_L2CAP_DYNAMIC_CHANNEL=y
CONFIG_BT_HCI_TX_STACK_SIZE=640
CONFIG_BT_HCI_HOST=y
CONFIG_BT_HCI_CMD_COUNT=2
CONFIG_BT_RX_BUF_COUNT=20
# Test lower value to save RAM (orig 1024)
CONFIG_BT_RX_BUF_LEN=512
CONFIG_BT_RECV_IS_RX_THREAD=y
CONFIG_BT_DEBUG_LOG=y
```

## src/main.c
```c
#include <zephyr.h>
#include <board.h>
#include <device.h>
#include <adc.h>
#include <hal/nrf_saadc.h>
#include <misc/printk.h>
#include <nrf_gpio.h>
#include <pwm.h>
#include <gpio.h>
#include "fsr.h"
#include "servo.h"

#define ADC_DEVICE_NAME		CONFIG_ADC_0_NAME
#define ADC_RESOLUTION		10
#define ADC_GAIN		ADC_GAIN_1_6
#define ADC_REFERENCE		ADC_REF_INTERNAL
#define ADC_ACQUISITION_TIME	ADC_ACQ_TIME(ADC_ACQ_TIME_MICROSECONDS, 10)
#define ADC_1ST_CHANNEL_ID	0
#define ADC_1ST_CHANNEL_INPUT	NRF_SAADC_INPUT_AIN1
#define ADC_2ND_CHANNEL_ID	2
#define ADC_2ND_CHANNEL_INPUT	NRF_SAADC_INPUT_AIN2

#define PWM_DRIVER CONFIG_PWM_NRF5_SW_0_DEV_NAME
#define PWM_CHANNEL LED0_GPIO_PIN
#define YOUR_PIN	NRF_GPIO_PIN_MAP(0,22)
#define PORT	CONFIG_GPIO_NRF5_P0_DEV_NAME
#define PIN		11

#define BTN_PORT	SW0_GPIO_CONTROLLER
#define BTN		SW0_GPIO_PIN


#define PERIOD (USEC_PER_SEC / 50)
#define BUFFER_SIZE  6


void main(void)
{
	int a;
	printf("Preparing ADC\n");

	//setup
	struct device *pwm_dev;
	struct device *btn_dev;
	
	u32_t time_stamp;
	u32_t milliseconds_spent;
	

	btn_dev = device_get_binding(BTN_PORT);
	gpio_pin_configure(btn_dev, BTN, GPIO_DIR_IN | GPIO_PUD_PULL_UP);
	printk("PWM servo control 90degree clockwise -> 90degree anticlockwise\n");
	pwm_dev = device_get_binding(PWM_DRIVER);
	if (!pwm_dev) {
		printk("Cannot find %s!\n", PWM_DRIVER);
		return;
	}

	/* capture initial time stamp */
	time_stamp = k_uptime_get_32();
	u32_t time_until = get_time_to(1501, 1502) + time_stamp;
	time_until = time_until / 15;
	printf("%" PRIu32 "\n", time_stamp);
	printf("%" PRIu32 "\n", time_until);



	while (true) {
		k_sleep(500);
		int b = sample_sensor(ADC_1ST_CHANNEL_ID);
		printf("%d \n", b);

		/* compute how long the work took (also updates the time stamp) */
		milliseconds_spent = k_uptime_get_32();
		if(milliseconds_spent >= (time_until) && milliseconds_spent <=(time_until+1000)){
			a = sampling();
			printf("%d sample \n", a);
			printf("%" PRIu32 "\n", milliseconds_spent);
			//fill_up(pwm_dev, a);
			k_sleep(MSEC_PER_SEC);
			time_stamp = k_uptime_get_32();
		}

	}
}
```

## src/fsr.c
```c
#include <zephyr.h>
#include <board.h>
#include <device.h>
#include <adc.h>
#include <hal/nrf_saadc.h>
#include <misc/printk.h>
#include <nrf_gpio.h>
#include <pwm.h>
#include <gpio.h>


#define ADC_DEVICE_NAME		CONFIG_ADC_0_NAME
#define ADC_RESOLUTION		10
#define ADC_GAIN		ADC_GAIN_1_6
#define ADC_REFERENCE		ADC_REF_INTERNAL
#define ADC_ACQUISITION_TIME	ADC_ACQ_TIME(ADC_ACQ_TIME_MICROSECONDS, 10)
#define ADC_1ST_CHANNEL_ID	0
#define ADC_1ST_CHANNEL_INPUT	NRF_SAADC_INPUT_AIN1
#define ADC_2ND_CHANNEL_ID	2
#define ADC_2ND_CHANNEL_INPUT	NRF_SAADC_INPUT_AIN2

#define BUFFER_SIZE  6

static s16_t m_sample_buffer[BUFFER_SIZE];

static const struct adc_channel_cfg m_1st_channel_cfg = {
	.gain             = ADC_GAIN,
	.reference        = ADC_REFERENCE,
	.acquisition_time = ADC_ACQUISITION_TIME,
	.channel_id       = ADC_1ST_CHANNEL_ID,
#if defined(CONFIG_ADC_CONFIGURABLE_INPUTS)
	.input_positive   = ADC_1ST_CHANNEL_INPUT,
#endif
};
#if defined(ADC_2ND_CHANNEL_ID)
static const struct adc_channel_cfg m_2nd_channel_cfg = {
	.gain             = ADC_GAIN,
	.reference        = ADC_REFERENCE,
	.acquisition_time = ADC_ACQUISITION_TIME,
	.channel_id       = ADC_2ND_CHANNEL_ID,
#if defined(CONFIG_ADC_CONFIGURABLE_INPUTS)
	.input_positive   = ADC_2ND_CHANNEL_INPUT,
#endif
};
#endif /* defined(ADC_2ND_CHANNEL_ID) */


static struct device *init_adc(void)
{
	int ret;
	struct device *adc_dev = device_get_binding(ADC_DEVICE_NAME);

	if (!adc_dev) {
		printf("Cannot get ADC device");
		return;
	}

	ret = adc_channel_setup(adc_dev, &m_1st_channel_cfg);
	if (ret) {
		printf("Setting up of the first channel failed with code %d", ret);
	}

#if defined(ADC_2ND_CHANNEL_ID)
	ret = adc_channel_setup(adc_dev, &m_2nd_channel_cfg);
	if (ret) {
		printf("Setting up of the second channel failed with code %d", ret);
	}
#endif /* defined(ADC_2ND_CHANNEL_ID) */

	(void)memset(m_sample_buffer, 0, sizeof(m_sample_buffer));

	return adc_dev;
}

int sample_sensor (int channel_id)
{
	int ret;

	const struct adc_sequence sequence = {
		.channels    = BIT(channel_id),
		.buffer      = m_sample_buffer,
		.buffer_size = sizeof(m_sample_buffer),
		.resolution  = ADC_RESOLUTION,
	};

	struct device *adc_dev = init_adc();

	if (!adc_dev) {
		printf("Failed to initialise ADC");
		return -1;
	}

	ret = adc_read(adc_dev, &sequence);

	if (ret) {
		printf("Failed to read ADC with code %d", ret);
	}

	return m_sample_buffer[0];
}

int sampling()
{
	int sample;
	int bowlFill;
	for(int i = 0; i < 4; i++){
		k_sleep(500);
		printk("\nSampling ... ");

		sample = sample_sensor(ADC_1ST_CHANNEL_ID);

		if(sample < 170){
			printf("Bowl is emptyish");
			bowlFill = 0;
		} else if(sample >= 170 && sample <= 430){
			printf("Bowl is 1/4 fullish");
			bowlFill = 25;
		} else if(sample > 430 && sample <= 570){
			printf("Bowl is 1/2 fullish");
			bowlFill = 50;
		} else if(sample > 570 && sample <= 670){
			printf("Bowl is 3/4 fullish");
			bowlFill = 75;
		} else{
			printf("Bowl is fullish");
			bowlFill = 100;
		}

		printk("%d \n", sample);
	}
	return bowlFill;
}
```

## src/servo.c
```c
#include <zephyr.h>
#include <board.h>
#include <device.h>
#include <adc.h>
#include <hal/nrf_saadc.h>
#include <misc/printk.h>
#include <nrf_gpio.h>
#include <pwm.h>
#include <gpio.h>
#include "fsr.h"

#define PWM_DRIVER CONFIG_PWM_NRF5_SW_0_DEV_NAME
#define PWM_CHANNEL LED0_GPIO_PIN
#define YOUR_PIN	NRF_GPIO_PIN_MAP(0,22)
#define PORT	CONFIG_GPIO_NRF5_P0_DEV_NAME
#define PIN		11

#define BTN_PORT	SW0_GPIO_CONTROLLER
#define BTN		SW0_GPIO_PIN


#define PERIOD (USEC_PER_SEC / 50)

void turn_clockwise (struct device *pwm_dev){
		u32_t pulse_width = PERIOD;
		if (pwm_pin_set_usec(pwm_dev, YOUR_PIN, PERIOD, pulse_width)) {
			printk("pwm pin set fails\n");
			return;
		}
		pulse_width -=200;
		k_sleep(90);
		if (pwm_pin_set_usec(pwm_dev, YOUR_PIN, PERIOD, pulse_width)) {
			printk("pwm pin set fails\n");
			return;
		}
		pulse_width = -200;
		k_sleep(90);
		if (pwm_pin_set_usec(pwm_dev, YOUR_PIN, PERIOD, pulse_width)) {
			printk("pwm pin set fails\n");
			return;
		}
}

void turn_anticlockwise (struct device *pwm_dev){
		u32_t pulse_width = 0;
		if (pwm_pin_set_usec(pwm_dev, YOUR_PIN, PERIOD, pulse_width)) {
			printk("pwm pin set fails\n");
			return;
		}
		pulse_width +=200;
		k_sleep(90);
		if (pwm_pin_set_usec(pwm_dev, YOUR_PIN, PERIOD, pulse_width)) {
			printk("pwm pin set fails\n");
			return;
		}
		pulse_width += 200;
		k_sleep(90);
		if (pwm_pin_set_usec(pwm_dev, YOUR_PIN, PERIOD, pulse_width)) {
			printk("pwm pin set fails\n");
			return;
		}
}

void fill_up(struct device *pwm_dev, int sample){
	while(sample < 100){
		turn_clockwise(pwm_dev);
		pwm_pin_set_usec(pwm_dev, YOUR_PIN, 0, 0);
		k_sleep(MSEC_PER_SEC/20);
		turn_anticlockwise(pwm_dev);
		pwm_pin_set_usec(pwm_dev, YOUR_PIN, 0, 0);
		sample = sampling();
		//k_sleep(MSEC_PER_SEC);
	}
}

//given the current time, calculate the length of time until the next feeding time.
//next feeding time must be the next 
u32_t get_time_to(u32_t start_time, u32_t end_time)
{
    u32_t time_diff_in_mins = 0;
    u32_t start_min = start_time % 100;
    u32_t start_hour = start_time / 100;
    u32_t end_min = end_time % 100;
    u32_t end_hour = end_time / 100;

    if (end_time < start_time)
    {
        end_hour += 12;
        time_diff_in_mins += 12*60;
    }
    if (end_min > start_min)
    {
        time_diff_in_mins += end_min - start_min;
        time_diff_in_mins += 60*(end_hour - start_hour); 
    }
    else
    {
        time_diff_in_mins += 60 - start_min + end_min;
        start_hour += 1;
        time_diff_in_mins += 60*(end_hour - start_hour);
    }
    
    
    return time_diff_in_mins * 60000;
}
```

## src/servo.h
```c
#ifndef __SERVO_H__
#define __SERVO_H__

void fill_up(struct device *, int sample);

#endif
```
